## server/sdkconfig.defaults
```kconfig
# Tokio current_thread runtime runs everything on this single stack.
# 112KB is needed because hickory-resolver's async DNS parsing creates deeply
# nested futures that consume ~111KB of stack with opt-level "z" (no inlining).
# This stack lives in internal SRAM, not PSRAM, so it can't grow much further.
CONFIG_ESP_MAIN_TASK_STACK_SIZE=114688

# Use this to set FreeRTOS kernel tick frequency to 1000 Hz (100 Hz by default).
# This allows to use 1 ms granularity for thread sleeps (10 ms by default).
#CONFIG_FREERTOS_HZ=1000

# We use rustls, not mbedtls - disable to save RAM and flash
CONFIG_MBEDTLS_CERTIFICATE_BUNDLE=n
CONFIG_MBEDTLS_CERTIFICATE_BUNDLE_DEFAULT_FULL=n
CONFIG_MBEDTLS_TLS_ENABLED=n

# Enable PSRAM (ESP32-WROVER has 4MB SPI PSRAM)
CONFIG_ESP32_SPIRAM_SUPPORT=y
CONFIG_SPIRAM=y
CONFIG_SPIRAM_USE_MALLOC=y
CONFIG_SPIRAM_MALLOC_ALWAYSINTERNAL=0
CONFIG_SPIRAM_MALLOC_RESERVE_INTERNAL=0
# Allow task stacks in PSRAM — frees internal SRAM for FreeRTOS/lwIP
CONFIG_SPIRAM_ALLOW_STACK_EXTERNAL_MEMORY=y

# Use static WiFi TX buffers — avoids dynamic internal SRAM allocation
CONFIG_ESP32_WIFI_STATIC_TX_BUFFER=y
CONFIG_ESP32_WIFI_STATIC_TX_BUFFER_NUM=8

# Increase lwIP buffers for concurrent QUIC relay probes
CONFIG_LWIP_UDP_RECVMBOX_SIZE=32
CONFIG_LWIP_TCP_SND_BUF_DEFAULT=8192
CONFIG_LWIP_TCP_WND_DEFAULT=8192
CONFIG_LWIP_TCPIP_RECVMBOX_SIZE=32
CONFIG_LWIP_TCPIP_TASK_STACK_SIZE=4096
CONFIG_LWIP_MAX_UDP_PCBS=16
CONFIG_LWIP_MAX_SOCKETS=16

# Detect stack overflow via hardware watchpoint (uses 1 of 2 debug watchpoints)
CONFIG_FREERTOS_WATCHPOINT_END_OF_STACK=y
```
